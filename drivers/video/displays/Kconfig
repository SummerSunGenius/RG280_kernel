## drivers/video/displays/Kconfig
```kconfig
#
# Displays configuration
#

menu "Display Device Drivers"

config PANEL_NT39016
	# TODO: Switch to tristate once the driver is a module.
	bool "Novatek NT39016 based panel"
	help
	  Select this if you are using a Novatek NT39016 LCD driver IC.
config PANEL_NV3052C
  # TODO: Switch to tristate once the driver is a module.
  bool "NV3052C based panel"
  help
    Select this if you are using a NV3052C LCD driver IC.
config PANEL_RG280
  # TODO: Switch to tristate once the driver is a module.
  bool "RG280 based panel"
  help
    Select this if you are using a RG280 LCD driver IC.
endmenu
```
